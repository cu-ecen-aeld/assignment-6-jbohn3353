## df/conf/bblayers.conf
```bitbake
# POKY_BBLAYERS_CONF_VERSION is increased each time build/conf/bblayers.conf
# changes incompatibly
POKY_BBLAYERS_CONF_VERSION = "2"

BBPATH = "${TOPDIR}"
BBFILES ?= ""

BBLAYERS ?= " \
  /home/jabo7506/Documents/a6/poky/meta \
  /home/jabo7506/Documents/a6/poky/meta-poky \
  /home/jabo7506/Documents/a6/poky/meta-yocto-bsp \
  "
```
